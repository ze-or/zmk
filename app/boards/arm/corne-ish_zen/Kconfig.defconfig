## app/boards/arm/corne-ish_zen/Kconfig.defconfig
```kconfig
#
# Copyright (c) 2021 Darryl deHaan
# SPDX-License-Identifier: MIT
#

if BOARD_CORNEISH_ZEN_LEFT

config ZMK_KEYBOARD_NAME
	default "Corne-ish Zen"

config ZMK_SPLIT_ROLE_CENTRAL
	default y

endif # BOARD_CORNEISH_ZEN_LEFT


if BOARD_CORNEISH_ZEN_LEFT || BOARD_CORNEISH_ZEN_RIGHT

config BOARD
	default "corne-ish_zen"

config ZMK_SPLIT
	default y

config I2C
	bool
	default y

config SENSOR
    bool "Sensor Drivers"

config BQ274XX
    bool "BQ274xx Fuel Gauge"
    depends on I2C && SENSOR

config SENSOR_CAN_FETCH_ALL
	bool "Can the fuel gauge fetch all channels at once"
	default y

config SPI
    bool
    default y

config BT_CTLR
	default BT

config ZMK_BLE
	default y

config ZMK_USB
	default y

if USB

config USB_NRFX
	default y

config USB_DEVICE_STACK
	default y

endif # USB

config ZMK_DISPLAY

if ZMK_DISPLAY

config SPI
	default y

config IL0323
	bool
	default y

config ZMK_DISPLAY_BLANK_ON_IDLE
	default n

choice ZMK_DISPLAY_STATUS_SCREEN
	default ZMK_DISPLAY_STATUS_SCREEN_CUSTOM

endchoice

choice ZEN_STATUS_SCREEN
	prompt "Status screen layout"

config ZEN_STATUS_SCREEN_STOCK
	bool "Stock Zen status screen"
	select LVGL_USE_CONT
	select LVGL_FONT_MONTSERRAT_26
	select LVGL_FONT_MONTSERRAT_20
	select LVGL_FONT_MONTSERRAT_16
	select LVGL_USE_LABEL
	select LVGL_USE_IMG

config ZEN_STATUS_SCREEN_8BIT
	bool "8-bit playing cards themed status screen"
	select LVGL_USE_LABEL
	select LVGL_USE_IMG

endchoice # ZEN_STATUS_SCREEN

if ZEN_STATUS_SCREEN_STOCK

config CUSTOM_WIDGET_BATTERY_STATUS
	bool "custom battery status widget"

config CUSTOM_WIDGET_OUTPUT_STATUS
	bool "custom output status widget"

config CUSTOM_WIDGET_LAYER_STATUS
	bool "custom layer status widget"

config CUSTOM_WIDGET_PERIPHERAL_STATUS
	bool "custom peripheral status widget"

config CUSTOM_WIDGET_LAYER_STATUS_HIDE_HEADING
	bool "Hide heading strip for layer widget"
	depends on CUSTOM_WIDGET_LAYER_STATUS

choice CUSTOM_WIDGET_LOGO_IMAGE
	prompt "custom logo widget image"
	default CUSTOM_WIDGET_LOGO_IMAGE_ZEN
	help
	  Image used in custom logo widget
	config CUSTOM_WIDGET_LOGO_IMAGE_ZEN
		bool "Corne-ish Zen"
	config CUSTOM_WIDGET_LOGO_IMAGE_LPKB
		bool "LPKB"
	config CUSTOM_WIDGET_LOGO_IMAGE_ZMK
		bool "ZMK"
	config CUSTOM_WIDGET_LOGO_IMAGE_MIRYOKU
		bool "Miryoku"
endchoice

endif # ZEN_STATUS_SCREEN_STOCK

endif # ZMK_DISPLAY

endif # BOARD_CORNEISH_ZEN_LEFT || BOARD_CORNEISH_ZEN_RIGHT
```

## app/dts/bindings/behaviors/zmk,behavior-smart-interrupt.yaml
```yaml
# Copyright (c) 2022 The ZMK Contributors
# SPDX-License-Identifier: MIT

description: Smart Interrupt Behavior

compatible: "zmk,behavior-smart-interrupt"

include: zero_param.yaml

properties:
  bindings:
    type: phandle-array
    required: true
  ignored-key-positions:
    type: array
    required: false
    default: []
  ignored-layers:
    type: array
    required: false
    default: []
  timeout-ms:
    type: int
    default: -1
  tap-ms:
    type: int
    default: 5
```

## app/src/display/custom/Kconfig
```kconfig
config LVGL_FONT_MONTSERRAT_16
    default y

choice LVGL_THEME_DEFAULT_FONT_NORMAL
    default LVGL_THEME_DEFAULT_FONT_NORMAL_MONTSERRAT_16

endchoice

config LVGL_FONT_MONTSERRAT_12
    default y

choice LVGL_THEME_DEFAULT_FONT_SMALL
    default LVGL_THEME_DEFAULT_FONT_SMALL_MONTSERRAT_12

endchoice
```

## app/src/display/widgets/Kconfig
```kconfig
# Copyright (c) 2020 The ZMK Contributors
# SPDX-License-Identifier: MIT

menu "ZMK Display Widgets"

config ZMK_WIDGET_LAYER_STATUS
    bool "Widget for highest, active layer using small icons"
    default y
    depends on !ZMK_SPLIT || ZMK_SPLIT_ROLE_CENTRAL
    select LVGL_USE_LABEL

config ZMK_WIDGET_BATTERY_STATUS
    bool "Widget for battery charge information, using small icons"
    depends on BT
    default y if BT
    select LVGL_USE_LABEL

config ZMK_WIDGET_OUTPUT_STATUS
    bool "Widget for keyboard output status icons"
    depends on BT && (!ZMK_SPLIT_BLE || ZMK_SPLIT_ROLE_CENTRAL)
    default y if BT && (!ZMK_SPLIT_BLE || ZMK_SPLIT_ROLE_CENTRAL)
    select LVGL_USE_LABEL

config ZMK_WIDGET_PERIPHERAL_STATUS
    bool "Widget for split peripheral status icons"
    depends on BT && ZMK_SPLIT_BLE && !ZMK_SPLIT_ROLE_CENTRAL
    default y if BT && ZMK_SPLIT_BLE && !ZMK_SPLIT_ROLE_CENTRAL
    select LVGL_USE_LABEL
    select LVGL_USE_IMG
    
config ZMK_WIDGET_WPM_STATUS
    bool "Widget for displaying typed words per minute"
    depends on !ZMK_SPLIT || ZMK_SPLIT_ROLE_CENTRAL
    select LVGL_USE_LABEL
    select ZMK_WPM

config ZMK_WIDGET_FOX
    bool "Widget for displaying animated FFKB fox"
    select LVGL_USE_IMG
    select LVGL_USE_ANIMATION
    select ZMK_WPM

if ZMK_WIDGET_FOX

config ZMK_WIDGET_FOX_SLOW_LIMIT
    int "Upper limit for WPM for showing slow typing animation"
    default 30

endif # ZMK_WIDGET_FOX

endmenu
```
